## sip-plugin/Config.in
```kconfig
if PACKAGE_sip-plugin

config PLUGIN
	bool "Build the package as a sysrepo plugin"
	default y

endif
```

## wireless-plugin/Config.in
```kconfig
if PACKAGE_terastream

config PLUGIN
	bool "Build the package as a sysrepo plugin"
	default y

endif
```
